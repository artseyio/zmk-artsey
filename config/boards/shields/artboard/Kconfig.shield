## config/boards/shields/artboard/Kconfig.shield
```kconfig
# Copyright (c) 2021 Dennis "depadiernos" Padiernos
# SPDX-License-Identifier: MIT

config SHIELD_ARTBOARD_LEFT
	def_bool $(shields_list_contains,artboard_left)

config SHIELD_ARTBOARD_RIGHT
	def_bool $(shields_list_contains,artboard_right)
```

## config/boards/shields/bluehand/Kconfig.defconfig
```kconfig
if SHIELD_BLUEHAND_LEFT || SHIELD_BLUEHAND_RIGHT

config ZMK_KEYBOARD_NAME
	default "BlueHand"

endif
```

## config/boards/shields/bluehand/Kconfig.shield
```kconfig
# Copyright (c) 2021 Mike "KemoNine" Crosson
# SPDX-License-Identifier: MIT

config SHIELD_BLUEHAND_LEFT
	def_bool $(shields_list_contains,bluehand_left)

config SHIELD_BLUEHAND_RIGHT
	def_bool $(shields_list_contains,bluehand_right)
```

## config/boards/shields/corne_artsey_right/Kconfig.shield
```kconfig
# Copyright (c) 2021 Mike "KemoNine" Crosson
# SPDX-License-Identifier: MIT

config SHIELD_CORNE_ARTSEY_RIGHT
	def_bool $(shields_list_contains,corne_artsey_right)
```

## config/boards/shields/corne_left/Kconfig.shield
```kconfig
# Copyright (c) 2021 Mike "KemoNine" Crosson
# SPDX-License-Identifier: MIT

config SHIELD_CORNE_ARTSEY_LEFT
	def_bool $(shields_list_contains,corne_artsey_left)

config SHIELD_CORNE_5_COL_ARTSEY_LEFT
	def_bool $(shields_list_contains,corne_5_col_artsey_left)
```

## config/boards/shields/corne_right/Kconfig.shield
```kconfig
# Copyright (c) 2021 Mike "KemoNine" Crosson
# SPDX-License-Identifier: MIT

config SHIELD_CORNE_ARTSEY_RIGHT
	def_bool $(shields_list_contains,corne_artsey_right)

config SHIELD_CORNE_5_COL_ARTSEY_RIGHT
	def_bool $(shields_list_contains,corne_5_col_artsey_right)
```

## config/boards/shields/cradio_left/Kconfig.defconfig
```kconfig
# Copyright (c) 2020 The ZMK Contributors
# SPDX-License-Identifier: MIT

if SHIELD_CRADIO_ARTSEY_LEFT || SHIELD_CRADIO_ARTSEY_THUMB_LEFT

config ZMK_KEYBOARD_NAME
	default "Artsey L"

endif
```

## config/boards/shields/cradio_left/Kconfig.shield
```kconfig
# Copyright (c) 2020 The ZMK Contributors
# SPDX-License-Identifier: MIT

config SHIELD_CRADIO_ARTSEY_LEFT
	def_bool $(shields_list_contains,cradio_artsey_left)

config SHIELD_CRADIO_ARTSEY_THUMB_LEFT
	def_bool $(shields_list_contains,cradio_artsey_thumb_left)
```

## config/boards/shields/cradio_right/Kconfig.defconfig
```kconfig
# Copyright (c) 2020 The ZMK Contributors
# SPDX-License-Identifier: MIT

if SHIELD_CRADIO_ARTSEY_RIGHT || SHIELD_CRADIO_ARTSEY_THUMB_RIGHT

config ZMK_KEYBOARD_NAME
	default "Artsey R"

endif
```

## config/boards/shields/cradio_right/Kconfig.shield
```kconfig
# Copyright (c) 2020 The ZMK Contributors
# SPDX-License-Identifier: MIT

config SHIELD_CRADIO_ARTSEY_RIGHT
	def_bool $(shields_list_contains,cradio_artsey_right)

config SHIELD_CRADIO_ARTSEY_THUMB_RIGHT
	def_bool $(shields_list_contains,cradio_artsey_thumb_right)
```

## config/boards/shields/the_paintbrush/Kconfig.shield
```kconfig
# Copyright (c) 2021 Mike "KemoNine" Crosson
# SPDX-License-Identifier: MIT

config SHIELD_THE_PAINTBRUSH_LEFT
	def_bool $(shields_list_contains,the_paintbrush_left)

config SHIELD_THE_PAINTBRUSH_RIGHT
	def_bool $(shields_list_contains,the_paintbrush_right)
```

## config/boards/shields/tidbit_artsey_left/Kconfig.shield
```kconfig
# Copyright (c) 2021 Mike "KemoNine" Crosson
# SPDX-License-Identifier: MIT

config SHIELD_TIDBIT_ARTSEY_LEFT
	def_bool $(shields_list_contains,tidbit_artsey_left)
```

## config/shields/corne_artsey_left/Kconfig.shield
```kconfig
# Copyright (c) 2020 Pete Johanson
# SPDX-License-Identifier: MIT

config SHIELD_CORNE_ARTSEY_LEFT
	def_bool $(shields_list_contains,corne_artsey_left)
```

## config/west.yml
```yaml
manifest:
  remotes:
    - name: zmkfirmware
      url-base: https://github.com/artseyio
    - name: zmk-artsey
      url-base: https://github.com/artseyio
  projects:
    - name: zmk
      remote: zmkfirmware
      revision: artsey
      import: app/west.yml
  self:
    path: config
```
