/*
 * Copyright (c) 2020 The ZMK Contributors
 *
 * SPDX-License-Identifier: MIT
 */

#include <behaviors.dtsi>
#include <dt-bindings/zmk/keys.h>
#include <dt-bindings/zmk/bt.h>

// Enable ARTSEY Right
#define ARTSEY_RIGHT 1

// ARTS Row
#define KEY_A 1
#define KEY_R 2
#define KEY_T 3
#define KEY_S 4
// EYIO Row
#define KEY_E 6
#define KEY_Y 7
#define KEY_I 8
#define KEY_O 9

// Define Custom Thumb Keys
#define CUSTOM_THUMB &kp ENTER &kp SPACE

// Define Offsets
#define LEADING_NONES NONE(0,0,1)
#define MIDDLE_NONES NONE(0,0,1)
#define TRAILING_NONES NONE(0,0,5)

// Include main artsey.io keymap
#include "../../../artsey.dtsi"
