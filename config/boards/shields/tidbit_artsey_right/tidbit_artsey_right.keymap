/*
 * Copyright (c) 2021 Mike "KemoNine" Crosson
 *
 * SPDX-License-Identifier: MIT
 */

#include <behaviors.dtsi>
#include <dt-bindings/zmk/keys.h>
#include <dt-bindings/zmk/bt.h>

// Enable ARTSEY Left
#define ARTSEY_LEFT 1

// ARTS Row
#define KEY_A 7
#define KEY_R 6
#define KEY_T 5
#define KEY_S 4
// EYIO Row
#define KEY_E 12
#define KEY_Y 11
#define KEY_I 10
#define KEY_O 9

// Define Offsets
#define LEADING_NONES NONE(0,0, 4)
#define MIDDLE_NONES NONE(0, 0, 1)
#define TRAILING_NONES NONE(0, 0, 6)

// Include main artsey.io keymap
#include "../../../artsey.dtsi"
