/*
 * Copyright (c) 2020 The ZMK Contributors
 *
 * SPDX-License-Identifier: MIT
 */

#include <behaviors.dtsi>
#include <dt-bindings/zmk/keys.h>
#include <dt-bindings/zmk/bt.h>

// Enable ARTSEY Left
#define ARTSEY_LEFT 1

// ARTS Row
#define KEY_A 8
#define KEY_R 7
#define KEY_T 6
#define KEY_S 5
// EYIO Row
#define KEY_E 13
#define KEY_Y 12
#define KEY_I 11
#define KEY_O 10

// Define Custom Thumb Keys
#define CUSTOM_THUMB &kp SPACE &kp ENTER

// Define Offsets
#define LEADING_NONES NONE(0,0,5)
#define MIDDLE_NONES NONE(0,0,1)
#define TRAILING_NONES NONE(0,0,1)

// Include main artsey.io keymap
#include "../../../artsey.dtsi"
